## code/main/Kconfig.projbuild
```kconfig
menu "Server"

    config SERVER_URI
        string "Websocket Server"
        default "wss://dev.pyfi.org"
        help
            URL of websocket (uses different endpoints).

endmenu

menu "Thermostat"

    config ONE_WIRE_GPIO
        int "Sensor IO (ds18b20)"
    	range 0 34
    	default 22
    	help
    		GPIO number (IOxx) to access One Wire Bus.

    		Some GPIOs are used for other purposes (flash connections, etc.) and cannot be used.

    		GPIOs 35-39 are input-only so cannot be used to drive the One Wire Bus.

    config TEMP_SET_POINT
      int "Target Water Temperature"
      default 19
      help
          Target temparture.

    config THERM_INVERT_IO
      int "Invert Heat/Cool IO"
      default 0
      help
          Invert IO for heat/cool.

    config CONTROL_POS_IO
      int "PEC Positive Terminal IO"
      default 25
      help
          IO for positive terminal on thermocooler.

    config CONTROL_NEG_IO
      int "PEC Negative Terminal IO"
      default 26
      help
          IO for negative terminal on thermocooler.
endmenu

menu "pH Control"

    config PH_ADC_CHANNEL
      int "ADC Channel Used For Measurement"
      default 6
      help
          ADC Channel Used For Measurement.

    config ACID_PUMP_IO
      int "Acid Pump IO"
      default 25
      help
          IO for acid pump to lower pH.

    config BASE_PUMP_IO
      int "Base Pump IO"
      default 26
      help
          IO for base pump to raise pH.
endmenu

menu "Electric Conductivity"

    config EC_SUPPLY_IO
      int "IO Used For Supply Power Measurement"
      default 22
      help
          IO Used For Supply Power For Measurement.

    config EC_ADC_CHANNEL
      int "ADC Channel Used For Measurement"
      default 6
      help
          ADC Channel Used For Measurement.

    config WATER_PUMP_IO
      int "IO Used For Water Pump"
      default 12
      help
          IO Used For Water Pump.

    config NUTRIENT_PUMP_IO
      int "IO Used For Nutrient Pump"
      default 13
      help
          IO Used For Nutrient Pump.

endmenu


menu "Wifi"

    config ESP_WIFI_SSID
        string "WiFi SSID"
        default "myssid"
        help
            SSID (network name) for the example to connect to.

    config ESP_WIFI_PASSWORD
        string "WiFi Password"
        default "mypassword"
        help
            WiFi password (WPA or WPA2) for the example to use.

    config ESP_MAXIMUM_RETRY
        int "Maximum retry"
        default 5
        help
            Set the Maximum retry to avoid station reconnecting to the AP unlimited when the AP is really inexistent.
endmenu

menu "Switch Configuration"

config SWITCH_IO
    int "Switch IO number"
	range 0 34
	default 25
	help
		GPIO number (IOxx) to access switch.

		Some GPIOs are used for other purposes (flash connections, etc.) and cannot be used.

		GPIOs 35-39 are input-only so cannot be used to drive the One Wire Bus.

endmenu

menu "I2C Configuration"

    menu "I2C Master"
        config I2C_MASTER_SCL
            int "SCL GPIO Num"
            default 19
            help
                GPIO number for I2C Master clock line.

        config I2C_MASTER_SDA
            int "SDA GPIO Num"
            default 18
            help
                GPIO number for I2C Master data line.

        config I2C_MASTER_PORT_NUM
            int "Port Number"
            default 1
            help
                Port number for I2C Master device.

        config I2C_MASTER_FREQUENCY
            int "Master Frequency"
            default 100000
            help
                I2C Speed of Master device.
    endmenu

    menu "I2C Slave"
        config I2C_SLAVE_SCL
            int "SCL GPIO Num"
            default 5
            help
                GPIO number for I2C Slave clock line.

        config I2C_SLAVE_SDA
            int "SDA GPIO Num"
            default 4
            help
                GPIO number for I2C Slave data line.

        config I2C_SLAVE_PORT_NUM
            int "Port Number"
            default 0
            help
                Port number for I2C Slave device.

        config I2C_SLAVE_ADDRESS
            hex "ESP Slave Address"
            default 0x28
            help
                Hardware Address of I2C Slave Port.
    endmenu

    menu "BH1750 Sensor"
        choice BH1750_ADDR
            prompt "BH1750 I2C Address"
            default BH1750_I2C_ADDRESS_LOW
            help
                Hardware address of BH1750, which is 2 types, and determined by ADDR terminal.

            config BH1750_I2C_ADDRESS_LOW
                bool "BH1750 I2C Address(ADDR=0)"
                help
                    I2C Address of BH1750 Sensor according to your schemetic configuration.

            config BH1750_I2C_ADDRESS_High
                bool "BH1750 I2C Address(ADDR=1)"
                help
                    I2C Address of BH1750 Sensor according to your schemetic configuration.
        endchoice

        config BH1750_ADDR
            hex
            default 0x5C if BH1750_I2C_ADDRESS_High
            default 0x23 if BH1750_I2C_ADDRESS_LOW

        choice BH1750_MODE
            prompt "BH1750 Operation Mode"
            default BH1750_ONETIME_L_RESOLUTION
            help
                Operation Mode of BH1750.
                Different mode means different resolution and measurement time.
            config BH1750_CONTINU_H_RESOLUTION
                bool "Continuously H-Resolution Mode"
                help
                    Resolution is 1lx, measurement time is typically 120ms.
            config BH1750_CONTINU_H_RESOLUTION2
                bool "Continuously H-Resolution Mode2"
                help
                    Resolution is 0.5lx, measurement time is typically 120ms.
            config BH1750_CONTINU_L_RESOLUTION
                bool "Continuously L-Resolution Mode"
                help
                    Resolution is 4lx, measurement time is typically 16ms.
            config BH1750_ONETIME_H_RESOLUTION
                bool "One Time H-Resolution Mode"
                help
                    Resolution is 1lx, measurement time is typically 120ms.
                    It is automatically set to Power Down mode after measurement.
            config BH1750_ONETIME_H_RESOLUTION2
                bool "One Time H-Resolution Mode2"
                help
                    Resolution is 0.5lx, measurement time is typically 120ms.
                    It is automatically set to Power Down mode after measurement.
            config BH1750_ONETIME_L_RESOLUTION
                bool "One Time L-Resolution Mode"
                help
                    Resolution is 4lx, measurement time is typically 16ms.
                    It is automatically set to Power Down mode after measurement.
        endchoice

        config BH1750_OPMODE
            hex
            default 0x10 if BH1750_CONTINU_H_RESOLUTION
            default 0x11 if BH1750_CONTINU_H_RESOLUTION2
            default 0x13 if BH1750_CONTINU_L_RESOLUTION
            default 0x20 if BH1750_ONETIME_H_RESOLUTION
            default 0x21 if BH1750_ONETIME_H_RESOLUTION2
            default 0x23 if BH1750_ONETIME_L_RESOLUTION

    endmenu

endmenu
```
